## Documentation/devicetree/bindings/regulator/qcom,pm660l-lcdb-regulator.yaml
```yaml
# SPDX-License-Identifier: (GPL-2.0-only OR BSD-2-Clause)
%YAML 1.2
---
$id: http://devicetree.org/schemas/regulator/qcom,pm660l-lcdb-regulator.yaml#
$schema: http://devicetree.org/meta-schemas/core.yaml#

title: Qualcomm PM660L LCD Bias (LCDB) Regulators

maintainers:
  - Liam Girdwood <lgirdwood@gmail.com>
  - Mark Brown <broonie@kernel.org>

description: |
  The PM660L LCDB block provides separate LDO and negative charge-pump
  (NCP) outputs backed by a shared boost converter and module-enable
  control. The short-circuit interrupt is routed through the PM660L
  SPMI device at USID 3.

properties:
  compatible:
    const: qcom,pm660l-lcdb-regulator

  reg:
    maxItems: 1

  interrupts:
    maxItems: 1

  interrupt-names:
    items:
      - const: sc-irq

  ldo:
    type: object
    $ref: regulator.yaml#
    unevaluatedProperties: false
    description: PM660L LCDB positive LDO output.

  ncp:
    type: object
    $ref: regulator.yaml#
    unevaluatedProperties: false
    description: PM660L LCDB negative charge-pump output.

required:
  - compatible
  - reg
  - interrupts
  - interrupt-names
  - ldo
  - ncp

additionalProperties: false

examples:
  - |
    #include <dt-bindings/interrupt-controller/irq.h>
    #include <dt-bindings/spmi/spmi.h>

    spmi {
      #address-cells = <2>;
      #size-cells = <0>;

      pmic@3 {
        compatible = "qcom,pm660l", "qcom,spmi-pmic";
        reg = <0x3 SPMI_USID>;
        #address-cells = <1>;
        #size-cells = <0>;

        lcdb: regulator@ec00 {
          compatible = "qcom,pm660l-lcdb-regulator";
          reg = <0xec00>;
          interrupts = <0x3 0xec 0x1 IRQ_TYPE_EDGE_RISING>;
          interrupt-names = "sc-irq";

          ldo {
            regulator-name = "lcdb_ldo";
            regulator-min-microvolt = <4000000>;
            regulator-max-microvolt = <6000000>;
          };

          ncp {
            regulator-name = "lcdb_ncp";
            regulator-min-microvolt = <4000000>;
            regulator-max-microvolt = <6000000>;
          };
        };
      };
    };
...
```

## patches/pm660l/Kconfig.fragment
```kconfig
config REGULATOR_QCOM_PM660L_LCDB
	tristate "Qualcomm PM660L LCDB regulator"
	depends on MFD_SPMI_PMIC
	depends on OF
	help
	  This driver supports the PM660L LCD bias/boost block. The block
	  exposes separate positive LDO and negative NCP regulator outputs
	  which share a boost converter and module enable control.
```
